/* Auto-generated from config/nx_mimosa_v33_regmap.yaml — DO NOT EDIT */
/* NX-MIMOSA v3.3 Device Tree Overlay */
/* (c) Nexellum d.o.o. */

/dts-v1/;
/plugin/;

/ {
    compatible = "xlnx,zynqmp";

    fragment@0 {
        target = <&amba>;
        __overlay__ {
            nx_mimosa_v33: nx-mimosa@40000000 {
                compatible = "nexellum,nx-mimosa-3.3";
                reg = <0x0 0x40000000 0x0 0x1000>;
                interrupt-parent = <&gic>;
                interrupts = <0 89 4>;  /* SPI 89, level high */
                clocks = <&zynqmp_clk 71>;
                clock-names = "aclk";

                /* Stream DMA channels */
                dma-names = "meas_in", "rt_out", "win_out", "off_out";

                /* NX-MIMOSA v3.3 specific */
                nexellum,version = <0x00030003>;
                nexellum,window-size-default = <30>;
                nexellum,max-targets = <8>;
                nexellum,state-dim = <4>;
                nexellum,n-models = <3>;
            };
        };
    };
};
