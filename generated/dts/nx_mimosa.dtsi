/*
 * NX-MIMOSA Device Tree Include
 * Auto-generated from system_config.yaml
 */

/ {
    nx_mimosa: nx-mimosa@80000000 {
        compatible = "nexellum,nx-mimosa-1.1";
        reg = <0x0 0x80000000 0x0 0x1000>;
        interrupt-parent = <&gic>;
        interrupts = <0 89 4>;
        clocks = <&zynqmp_clk 71>;
        clock-names = "axi_clk";
        
        /* DMA channels */
        dmas = <&fpd_dma_chan0 0>;
        dma-names = "rx";
        
        /* Configuration */
        nexellum,cfar-window = <20>;
        nexellum,cfar-guard = <4>;
        nexellum,cognitive-enable = <1>;
    };
};
